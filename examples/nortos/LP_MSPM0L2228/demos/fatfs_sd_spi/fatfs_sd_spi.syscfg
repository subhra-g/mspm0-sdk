//@cliArgs --device "MSPM0L222X" --package "LQFP-80(PN)" --part "Default"
//@v2CliArgs --device "MSPM0L2228" --package "LQFP-80(PN)"
// @cliArgs --board /ti/boards/LP_MSPM0L2228 --rtos nortos

/**
 * Import the modules used in this configuration.
 */
const GPIO    = scripting.addModule("/ti/driverlib/GPIO", {}, false);
const GPIO1   = GPIO.addInstance();
const SPI     = scripting.addModule("/ti/driverlib/SPI", {}, false);
const SPI1    = SPI.addInstance();
const SYSCTL  = scripting.addModule("/ti/driverlib/SYSCTL");
const SYSTICK = scripting.addModule("/ti/driverlib/SYSTICK");
const TIMER   = scripting.addModule("/ti/driverlib/TIMER", {}, false);
const TIMER1  = TIMER.addInstance();

/**
 * Write custom configuration values to the imported modules.
 */
GPIO1.$name                                 = "SD_CS_GPIO";
GPIO1.associatedPins[0].$name               = "SD";
GPIO1.associatedPins[0].initialValue        = "SET";
GPIO1.associatedPins[0].assignedPort        = "PORTA";
GPIO1.associatedPins[0].internalResistor    = "PULL_UP";
GPIO1.associatedPins[0].assignedPortSegment = "Lower";
GPIO1.associatedPins[0].assignedPin         = "9";
GPIO1.associatedPins[0].pin.$assign         = "PA9";

const Board = scripting.addModule("/ti/driverlib/Board", {}, false);

SPI1.$name                              = "SD_SPI";
SPI1.frameFormat                        = "MOTO3";
SPI1.targetBitRate                      = 200000;
SPI1.sclkPinConfig.enableConfig         = true;
SPI1.sclkPinConfig.internalResistor     = "PULL_DOWN";
SPI1.sclkPinConfig.driveStrength        = "HIGH";
SPI1.mosiPinConfig.enableConfig         = true;
SPI1.mosiPinConfig.internalResistor     = "PULL_UP";
SPI1.misoPinConfig.internalResistor     = "PULL_UP";
SPI1.misoPinConfig.enableConfig         = true;
SPI1.peripheral.$assign                 = "SPI0";

SYSTICK.periodEnable  = true;
SYSTICK.period        = 32000;
SYSTICK.systickEnable = true;

TIMER1.$name           = "TIMER_0";
TIMER1.timerPeriod     = "1 ms";
TIMER1.timerMode       = "PERIODIC";
TIMER1.timerStartTimer = true;
TIMER1.interrupts      = ["LOAD"];
