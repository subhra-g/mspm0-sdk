//@cliArgs --device "MSPM0G321X" --package "LQFP-64(PM)" --part "Default"
//@v2CliArgs --device "MSPM0G3218" --package "LQFP-64(PM)"
// @cliArgs --board /ti/boards/LP_MSPM0G3218 --rtos nortos

/**
 * Import the modules used in this configuration.
 */
const NONMAIN       = scripting.addModule("/ti/driverlib/NONMAIN");
const ProjectConfig = scripting.addModule("/ti/project_config/ProjectConfig");

/**
 * Write custom configuration values to the imported modules.
 */
NONMAIN.nonmainWarning               = true;
NONMAIN.bslFlashPluginEnable         = true;
NONMAIN.bslPluginHookInitAddress     = 0x2000;
NONMAIN.bslPluginHookReceiveAddress  = 0x2100;
NONMAIN.bslPluginHookTransmitAddress = 0x2300;
NONMAIN.bslPluginHookDeInitAddress   = 0x2400;
NONMAIN.staticWriteProtectionMainLow = 0xFFFF00FF;
NONMAIN.staticWriteProtectionNonMain = true;
NONMAIN.bslPluginType                = "bslPluginI2C";
NONMAIN.bslPluginHookInit            = "BSL_PI_I2C_init";
NONMAIN.bslPluginHookReceive         = "BSL_PI_I2C_receive";
NONMAIN.bslPluginHookTransmit        = "BSL_PI_I2C_send";
NONMAIN.bslPluginHookDeInit          = "BSL_PI_I2C_deinit";

ProjectConfig.genLinker          = false;
ProjectConfig.genLibs            = false;
ProjectConfig.genOpts            = false;
